## config/boards/shields/Nalice/Kconfig.defconfig
```kconfig
if SHIELD_NALICE

config ZMK_KEYBOARD_NAME
  default "Nalice"

endif

if ZMK_DISPLAY

config I2C
    default y

config SSD1306
    default y

endif
```
